## boards/adi/max32625pico/Kconfig.max32625pico
```kconfig
# MAX32655EVKIT boards configuration

# Copyright (c) 2023-2024 Analog Devices, Inc.
# SPDX-License-Identifier: Apache-2.0

config BOARD_MAX32625PICO
	select SOC_MAX32655_M4 if BOARD_MAX32625PICO_MAX32655_M4
```

## boards/adi/max32625pico/board.yml
```yaml
# Copyright (c) 2023-2024 Analog Devices, Inc.
# SPDX-License-Identifier: Apache-2.0

board:
  name: max32625pico
  full_name: MAX32625PICO
  vendor: adi
  socs:
    - name: max32655
```
